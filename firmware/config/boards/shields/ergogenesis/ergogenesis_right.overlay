/*
 * Copyright (c) 2020 The ZMK Contributors
 *
 * SPDX-License-Identifier: MIT
 */

#include "ergogenesis.dtsi"

// Local columns 0-4 become split columns 5-9. The shared transform reverses
// these positions so the flipped PCB reads inner-to-pinky in keymap order.
&default_transform {
    col-offset = <5>;
};
